//@cliArgs --device "MSPM0G350X" --package "LQFP-64(PM)" --part "Default"
//@v2CliArgs --device "MSPM0G3507" --package "LQFP-64(PM)"
// @cliArgs --board /ti/boards/LP_MSPM0G3507 --rtos nortos

/**
 * Import the modules used in this configuration.
 */
const SYSCTL = scripting.addModule("/ti/driverlib/SYSCTL");

/**
 * Write custom configuration values to the imported modules.
 */

const Board = scripting.addModule("/ti/driverlib/Board", {}, false);

SYSCTL.SYSPLL_CLK2XEn    = true;
SYSCTL.SYSPLL_Pdiv       = 1;
SYSCTL.SYSPLL_Qdiv       = 5;
SYSCTL.SYSPLL_CLK2XDiv   = 3;
SYSCTL.MCLKSource        = "HSCLK";
SYSCTL.HSCLKSource       = "SYSPLLCLK2X";
SYSCTL.UDIV              = "2";
SYSCTL.validateClkStatus = true;

scripting.suppress("For best practices when the CPUCLK is running at 32MHz and above, clear the flash status bit using DL_FlashCTL_executeClearStatus\\(\\) before executing any flash operation\\. Otherwise there may be false positives\\.", SYSCTL);
